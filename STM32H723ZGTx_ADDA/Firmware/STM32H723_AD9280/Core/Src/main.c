/* USER CODE BEGIN Header */
/**
  ******************************************************************************
  * @file           : main.c
  * @brief          : Main program body
  ******************************************************************************
  * @attention
  *
  * Copyright (c) 2024 STMicroelectronics.
  * All rights reserved.
  *
  * This software is licensed under terms that can be found in the LICENSE file
  * in the root directory of this software component.
  * If no LICENSE file comes with this software, it is provided AS-IS.
  *
  ******************************************************************************
  */
/* USER CODE END Header */
/* Includes ------------------------------------------------------------------*/
#include "main.h"
#include "dma.h"
#include "tim.h"
#include "usart.h"
#include "gpio.h"

/* Private includes ----------------------------------------------------------*/
/* USER CODE BEGIN Includes */
#include "stdio.h"
#include "math.h"
/* USER CODE END Includes */

/* Private typedef -----------------------------------------------------------*/
/* USER CODE BEGIN PTD */

/* USER CODE END PTD */

/* Private define ------------------------------------------------------------*/
/* USER CODE BEGIN PD */

/* USER CODE END PD */

/* Private macro -------------------------------------------------------------*/
/* USER CODE BEGIN PM */

/* USER CODE END PM */

/* Private variables ---------------------------------------------------------*/

/* USER CODE BEGIN PV */

uint8_t AD9280_Done = 0;
uint32_t AD9280_Data_Buf[AD_BUF_SIZE];
uint32_t AD9708_Data_Buf[AD_BUF_SIZE] = 
{
127, 127, 127, 128, 128, 128, 128, 128, 129, 129, 129, 129,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 127
};

uint16_t data[4] = {
	
	0x0000, 0xFFFF,
	0x0000, 0xFFFF

	
};

/* USER CODE END PV */

/* Private function prototypes -----------------------------------------------*/
void SystemClock_Config(void);
static void MPU_Config(void);
/* USER CODE BEGIN PFP */

/* USER CODE END PFP */

/* Private user code ---------------------------------------------------------*/
/* USER CODE BEGIN 0 */
int fputc(int ch, FILE *f) {
	HAL_UART_Transmit(&huart1, (uint8_t *)&ch, 1, 0xffff);
	return ch;
}

void HAL_TIM_PeriodElapsedCallback(TIM_HandleTypeDef *htim) {
	if(htim->Instance == htim1.Instance) {
		

		
		
	}
	
	if(htim->Instance == htim8.Instance) {
		
//		HAL_TIM_DMABurst_ReadStop(&htim8, TIM_DMA_UPDATE);
//		AD9280_Done = 1;
		
	}
}

uint8_t Convert_Byte(uint8_t Data) 
{
	uint8_t Data1;
	Data1 = Data;
	Data = 0x00;

	for(int i = 0 ; i<(sizeof(uint8_t)*8/2) ; i++)
	{
		Data = Data | (Data1&(0X80>>i))>>(7-i*2);
		Data = Data | (Data1&(0X01<<i))<<(7-i*2);
	}

	return  Data;

}

// 生成一个包含 4096 个 8 位 sin 值的表
void generate_sin_table(uint32_t sin_table[]) {
    for (int i = 0; i < AD_BUF_SIZE; i++) {
        // 计算角度（弧度）
        double angle = (2 * 3.1415926 * i) / AD_BUF_SIZE;
        
        // 计算sin值
        double sin_value = sin(angle);
        
        // 将sin值映射到 0 到 255 的范围
        sin_table[i] = (uint32_t)((sin_value + 1.0) * 127.5); // 范围 [-1,1] 映射到 [0,255]
		
//		printf("{sin}%d\r\n", sin_table[i]);
    }
}
/* USER CODE END 0 */

/**
  * @brief  The application entry point.
  * @retval int
  */
int main(void)
{
  /* USER CODE BEGIN 1 */

  /* USER CODE END 1 */

  /* MPU Configuration--------------------------------------------------------*/
  MPU_Config();

  /* Enable I-Cache---------------------------------------------------------*/
  SCB_EnableICache();

  /* Enable D-Cache---------------------------------------------------------*/
  SCB_EnableDCache();

  /* MCU Configuration--------------------------------------------------------*/

  /* Reset of all peripherals, Initializes the Flash interface and the Systick. */
  HAL_Init();

  /* USER CODE BEGIN Init */

  /* USER CODE END Init */

  /* Configure the system clock */
  SystemClock_Config();

  /* USER CODE BEGIN SysInit */

  /* USER CODE END SysInit */

  /* Initialize all configured peripherals */
  MX_GPIO_Init();
  MX_DMA_Init();
  MX_USART1_UART_Init();
  MX_TIM8_Init();
  MX_TIM12_Init();
  MX_TIM1_Init();
  /* USER CODE BEGIN 2 */
	printf("STM32H723ZGT6\r\n");
	
//	generate_sin_table(AD9708_Data_Buf);
	SCB_CleanDCache_by_Addr((uint32_t *)AD9708_Data_Buf, sizeof(AD9708_Data_Buf));
//	
	for (int i = 0; i < AD_BUF_SIZE; i++) {
		printf("{sin}%d\r\n", AD9708_Data_Buf[i]);
	}
	
	TIM1->ARR = 250-1;
	TIM1->CCR1 = 125;
	HAL_TIM_PWM_Start(&htim1, TIM_CHANNEL_1);
	HAL_TIMEx_PWMN_Start(&htim1, TIM_CHANNEL_1);
	printf("{AD9708_TIM1}%fKHz, %fns\r\n", 250000.f/(float)(TIM1->ARR+1), (float)(TIM1->CCR1)/0.25f);
//	HAL_TIM_DMABurst_MultiWriteStart(&htim1, TIM_DMABASE_ARR, TIM_DMA_UPDATE, (uint32_t *)data, TIM_DMABURSTLENGTH_18TRANSFERS, 128);
//	uint8_t tmp = HAL_DMAEx_MultiBufferStart(&hdma_tim1_up, (uint32_t)AD9708_Data_Buf, (uint32_t)&GPIOB->BSRR, (uint32_t)AD9708_Data_Buf_1, AD_BUF_SIZE);
//	printf("{HAL_DMAEx_MultiBufferStart}%d\r\n", tmp);
//	HAL_DMA_Start(&hdma_tim1_up, (uint32_t)AD9708_Data_Buf, (uint32_t)&GPIOB->ODR, AD_BUF_SIZE);

	HAL_DMA_Start(htim1.hdma[TIM_DMA_ID_UPDATE],  (uint32_t)AD9708_Data_Buf, (uint32_t)&GPIOB->ODR, AD_BUF_SIZE);
//	htim1.Instance->DCR = (TIM_DMABASE_ARR | TIM_DMABURSTLENGTH_18TRANSFERS);
	__HAL_TIM_ENABLE_DMA(&htim1, TIM_DMA_UPDATE);
	
//	TIM8->ARR = 25-1;
//	TIM8->CCR1 = 7;
//	HAL_TIM_PWM_Start(&htim8, TIM_CHANNEL_1);
//	HAL_TIMEx_PWMN_Start(&htim8, TIM_CHANNEL_1);
//	printf("{AD9280_TIM8}%fKHz, %fns\r\n", 250000.f/(float)(TIM8->ARR+1), (float)(TIM8->CCR1)/0.25f);

//	HAL_TIM_DMABurst_MultiReadStart(&htim8, TIM_DMABASE_ARR, TIM_DMA_UPDATE, (uint32_t *)AD9280_Data_Buf, TIM_DMABURSTLENGTH_8TRANSFERS, AD_BUF_SIZE);
	
//	TIM12->ARR = 250-1;
//	TIM12->CCR1 = 125;
//	HAL_TIM_PWM_Start(&htim12, TIM_CHANNEL_1);
//	printf("{AD9708_TIM12}%fKHz, %fns\r\n", 250000.f/(float)(TIM12->ARR+1), (float)(TIM12->CCR1)/0.25f);
//	HAL_DMAEx_MultiBufferStart_IT(&hdma_dma_generator0, (uint32_t)AD9708_Data_Buf, (uint32_t)&GPIOB->ODR, (uint32_t)AD9708_Data_Buf_1, AD_BUF_SIZE);
	
	
  /* USER CODE END 2 */

  /* Infinite loop */
  /* USER CODE BEGIN WHILE */
  while (1)
  {
//		if(AD9280_Done == 1) {
//		  
//			for(int i = 0; i < AD_BUF_SIZE; i++) {
//				printf("{AD9280_Data}%d\r\n", AD9280_Data_Buf[i]);
//			}
//			
//			AD9280_Done = 0;
////			SCB_CleanDCache_by_Addr((uint32_t *)AD9280_Data_Buf, sizeof(AD9280_Data_Buf));
////			HAL_TIM_DMABurst_MultiReadStart(&htim8, TIM_DMABASE_ARR, TIM_DMA_UPDATE, (uint32_t *)AD9280_Data_Buf, TIM_DMABURSTLENGTH_8TRANSFERS, AD_BUF_SIZE);
//			
//		}
	  
    /* USER CODE END WHILE */

    /* USER CODE BEGIN 3 */
  }
  /* USER CODE END 3 */
}

/**
  * @brief System Clock Configuration
  * @retval None
  */
void SystemClock_Config(void)
{
  RCC_OscInitTypeDef RCC_OscInitStruct = {0};
  RCC_ClkInitTypeDef RCC_ClkInitStruct = {0};

  /** Supply configuration update enable
  */
  HAL_PWREx_ConfigSupply(PWR_LDO_SUPPLY);

  /** Configure the main internal regulator output voltage
  */
  __HAL_PWR_VOLTAGESCALING_CONFIG(PWR_REGULATOR_VOLTAGE_SCALE0);

  while(!__HAL_PWR_GET_FLAG(PWR_FLAG_VOSRDY)) {}

  /** Initializes the RCC Oscillators according to the specified parameters
  * in the RCC_OscInitTypeDef structure.
  */
  RCC_OscInitStruct.OscillatorType = RCC_OSCILLATORTYPE_HSE;
  RCC_OscInitStruct.HSEState = RCC_HSE_ON;
  RCC_OscInitStruct.PLL.PLLState = RCC_PLL_ON;
  RCC_OscInitStruct.PLL.PLLSource = RCC_PLLSOURCE_HSE;
  RCC_OscInitStruct.PLL.PLLM = 2;
  RCC_OscInitStruct.PLL.PLLN = 40;
  RCC_OscInitStruct.PLL.PLLP = 1;
  RCC_OscInitStruct.PLL.PLLQ = 2;
  RCC_OscInitStruct.PLL.PLLR = 2;
  RCC_OscInitStruct.PLL.PLLRGE = RCC_PLL1VCIRANGE_3;
  RCC_OscInitStruct.PLL.PLLVCOSEL = RCC_PLL1VCOWIDE;
  RCC_OscInitStruct.PLL.PLLFRACN = 0;
  if (HAL_RCC_OscConfig(&RCC_OscInitStruct) != HAL_OK)
  {
    Error_Handler();
  }

  /** Initializes the CPU, AHB and APB buses clocks
  */
  RCC_ClkInitStruct.ClockType = RCC_CLOCKTYPE_HCLK|RCC_CLOCKTYPE_SYSCLK
                              |RCC_CLOCKTYPE_PCLK1|RCC_CLOCKTYPE_PCLK2
                              |RCC_CLOCKTYPE_D3PCLK1|RCC_CLOCKTYPE_D1PCLK1;
  RCC_ClkInitStruct.SYSCLKSource = RCC_SYSCLKSOURCE_PLLCLK;
  RCC_ClkInitStruct.SYSCLKDivider = RCC_SYSCLK_DIV1;
  RCC_ClkInitStruct.AHBCLKDivider = RCC_HCLK_DIV2;
  RCC_ClkInitStruct.APB3CLKDivider = RCC_APB3_DIV2;
  RCC_ClkInitStruct.APB1CLKDivider = RCC_APB1_DIV2;
  RCC_ClkInitStruct.APB2CLKDivider = RCC_APB2_DIV2;
  RCC_ClkInitStruct.APB4CLKDivider = RCC_APB4_DIV2;

  if (HAL_RCC_ClockConfig(&RCC_ClkInitStruct, FLASH_LATENCY_3) != HAL_OK)
  {
    Error_Handler();
  }
}

/* USER CODE BEGIN 4 */

/* USER CODE END 4 */

/* MPU Configuration */

void MPU_Config(void)
{
  MPU_Region_InitTypeDef MPU_InitStruct = {0};

  /* Disables the MPU */
  HAL_MPU_Disable();

  /** Initializes and configures the Region and the memory to be protected
  */
  MPU_InitStruct.Enable = MPU_REGION_ENABLE;
  MPU_InitStruct.Number = MPU_REGION_NUMBER0;
  MPU_InitStruct.BaseAddress = 0x24000000;
  MPU_InitStruct.Size = MPU_REGION_SIZE_512KB;
  MPU_InitStruct.SubRegionDisable = 0x00;
  MPU_InitStruct.TypeExtField = MPU_TEX_LEVEL1;
  MPU_InitStruct.AccessPermission = MPU_REGION_FULL_ACCESS;
  MPU_InitStruct.DisableExec = MPU_INSTRUCTION_ACCESS_ENABLE;
  MPU_InitStruct.IsShareable = MPU_ACCESS_NOT_SHAREABLE;
  MPU_InitStruct.IsCacheable = MPU_ACCESS_CACHEABLE;
  MPU_InitStruct.IsBufferable = MPU_ACCESS_BUFFERABLE;

  HAL_MPU_ConfigRegion(&MPU_InitStruct);
  /* Enables the MPU */
  HAL_MPU_Enable(MPU_PRIVILEGED_DEFAULT);

}

/**
  * @brief  This function is executed in case of error occurrence.
  * @retval None
  */
void Error_Handler(void)
{
  /* USER CODE BEGIN Error_Handler_Debug */
  /* User can add his own implementation to report the HAL error return state */
  __disable_irq();
  while (1)
  {
  }
  /* USER CODE END Error_Handler_Debug */
}

#ifdef  USE_FULL_ASSERT
/**
  * @brief  Reports the name of the source file and the source line number
  *         where the assert_param error has occurred.
  * @param  file: pointer to the source file name
  * @param  line: assert_param error line source number
  * @retval None
  */
void assert_failed(uint8_t *file, uint32_t line)
{
  /* USER CODE BEGIN 6 */
  /* User can add his own implementation to report the file name and line number,
     ex: printf("Wrong parameters value: file %s on line %d\r\n", file, line) */
  /* USER CODE END 6 */
}
#endif /* USE_FULL_ASSERT */
